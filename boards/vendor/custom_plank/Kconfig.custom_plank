## boards/vendor/custom_plank/Kconfig.custom_plank
```kconfig
config BOARD_CUSTOM_PLANK
    bool "Custom STM32F4 Discovery Board"
    select SOC_STM32F407XX
    select BOARD_HAS_NRF5_BOOTLOADER if FLASH_LOAD_OFFSET
    help
      Enable support for the Custom STM32F4 Discovery Board.
```

## boards/vendor/custom_plank/board.yml
```yaml
# Custom Board Configuration for STM32F407
# SPDX-License-Identifier: Apache-2.0

board:
  name: custom_plank_stm32f4
  vendor: STMicroelectronics
  arch: arm
  type: mcu
  toolchain:
    - arm-zephyr-eabi
  supported:
    - zephyr
  flash: 1024        # Size of flash memory in KB (for STM32F407VG, 1MB flash)
  ram: 192           # Size of RAM in KB (for STM32F407VG, 192KB SRAM)
  soc: stm32f407vg
  serial:
    - uart
  peripherals:
    - gpio
    - spi
    - i2c
    - usb
    - adc
    - dac
  features:
    - mcu
    - watchdog
    - rtc
  connectors:
    - usb
    - uart
```

## boards/vendor/custom_plank/custom_plank_defconfig
```kconfig
# Custom board defconfig for STM32F4 Discovery

CONFIG_SOC="stm32f407xx"
CONFIG_BOARD="custom_plank"
CONFIG_UART_CONSOLE=y
CONFIG_GPIO=y
CONFIG_CLOCK_CONTROL=y
CONFIG_SERIAL=y
CONFIG_PINCTRL=y
```
