/dts-v1/;

/ {
    model = "Custom STM32F4 Discovery";
    compatible = "st,stm32f407";

    chosen {
        zephyr,console = &uart2;
        zephyr,shell-uart = &uart2;
        zephyr,uart-pm = &uart2;
    };
};

&uart2 {
    status = "okay";
    pinctrl-0 = <&uart2_tx &uart2_rx>;
    pinctrl-names = "default";
};

&gpioa {
    status = "okay";
};
