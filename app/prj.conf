## sample.yaml
```
# This file is provided so that the application can be compiled using Twister,
# the Zephyr testing tool. In this file, multiple combinations can be specified,
# so that you can easily test all of them locally or in CI.
sample:
  description: STM32F4 Disco UART application
  name: stm32f4_uart_application #Change to a relevant name according to your application
common:
  build_only: true
  integration_platforms:
    - stm32f4_disco
tests:
  app.default: {}
  app.debug:
    extra_overlay_confs:
      - debug.conf
```

## prj.conf
```kconfig
# Enable serial communication
CONFIG_SERIAL=y

# Enable UART console (optional)
CONFIG_UART_CONSOLE=y

# Enable ADC
CONFIG_ADC=y
```

## debug.conf
```kconfig
# Copyright (c) 2021 Nordic Semiconductor ASA
# SPDX-License-Identifier: Apache-2.0
#
# This is a Kconfig fragment which can be used to enable debug-related options
# in the application. See the README for more details.

# compiler
CONFIG_DEBUG_OPTIMIZATIONS=y

# logging
CONFIG_LOG=y
CONFIG_APP_LOG_LEVEL_DBG=y

# UART configuration for logging
CONFIG_SERIAL=y
CONFIG_UART_CONSOLE=y

# Ensure logging over UART is enabled
CONFIG_LOG_BACKEND_UART=y
CONFIG_LOG_BACKEND_UART_MINIMAL=y
```

## boards/stm32f4_disco.overlay
```dts
/* Example overlay for STM32F4 Discovery Board */

&usart2 {
    pinctrl-0 = <&usart2_tx_pa2 &usart2_rx_pa3>;
    pinctrl-names = "default";
    current-speed = <115200>;
    status = "okay";
};

&adc1 {
    status = "okay";
    pinctrl-0 = <&adc1_in0_pa0>;  // ADC input pin on PA0
    pinctrl-names = "default";
    st,adc-prescaler = <4>;  // Set prescaler, adjust based on needs
};
```

## src/main.c
```c
#include <zephyr/kernel.h>
#include <zephyr/device.h>
#include <zephyr/drivers/uart.h>
#include <zephyr/drivers/adc.h>
#include <zephyr/sys/printk.h>
#include <zephyr/devicetree.h>

/** UART defines */
#define UART_DEVICE_NODE DT_NODELABEL(usart2)

/** ADC defines */
#define ADC_NODE DT_NODELABEL(adc1)
#define ADC_RESOLUTION 12
#define ADC_CHANNEL_ID 0  // Corresponds to PA0 (ADC_IN0)

static const struct device *adc_dev = DEVICE_DT_GET(ADC_NODE);
static int16_t adc_buffer;

static const struct adc_channel_cfg channel_cfg = {
    .gain = ADC_GAIN_1,
    .reference = ADC_REF_INTERNAL,
    .acquisition_time = ADC_ACQ_TIME_DEFAULT,
    .channel_id = ADC_CHANNEL_ID,
};

/** Driver code starts below */
int main(void) {
    
    int ret;
    const struct device *uart_dev;

    if(!device_is_ready(adc_dev)) {
        printk("ADC device is not ready!");
        return -1;
    }

    // Configure ADC channel
    ret = adc_channel_setup(adc_dev, &channel_cfg);
    if (ret) {
        printk("ADC channel setup failed\n");
        return -1;
    }

    // Prepare ADC sequence
    struct adc_sequence sequence = {
        .channels = BIT(ADC_CHANNEL_ID),
        .buffer = &adc_buffer,
        .buffer_size = sizeof(adc_buffer),
        .resolution = ADC_RESOLUTION,
    };

    uart_dev = DEVICE_DT_GET(UART_DEVICE_NODE);
    if (!device_is_ready(uart_dev)) {
        printk("UART device not found!\n");
        return -1;  // Return an error code if UART is not ready
    }

    printk("UART device is ready!\n");

    // Infinite loop to keep the program running as is common in embedded applications
    while (1) {

        // Read ADC value
        ret = adc_read(adc_dev, &sequence);

        if (ret < 0) {
            printk("ADC read error: %d\n", ret);
        } else {
            printk("MQ-135 ADC Value: %d\n", adc_buffer);
        }

        k_sleep(K_MSEC(1000));  // Sleep for 1000 milliseconds (1 second)
    }

    return 0;  // Returning 0 to indicate successful execution (though we never reach this point)
}
```
